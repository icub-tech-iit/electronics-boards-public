// File generated 24/03/2016 15:04:27
// Warning! This is a generated file, any manual changes will be
// lost during the next generation.

// object indexes for Inputs, Image Addresses + Input Array
#CONST
    iCPUH             0x0000
    iCPUL             0x0000
    iMotorsH          0x0000
    iMotorsL          0x0E00
    iBattery_currentH 0x0000
    iBattery_currentL 0x1E00
    iCPU_voltageH     0x0002
    iCPU_voltageL     0x5800
    iiCPU_voltageH    0x0002
    iiCPU_voltageL    0x5C00
    iCPU_currentH     0x0002
    iCPU_currentL     0x6800
    iiCPU_currentH    0x0002
    iiCPU_currentL    0x6C00
    iBattery_voltageH 0x0002
    iBattery_voltageL 0x7800
    iGauge1H          0x0004
    iGauge1L          0x4600
    iBattery_percentH 0x0006
    iBattery_percentL 0x7000
    iiBattery_percentH 0x0006
    iiBattery_percentL 0x7200
    iMotors_voltageH  0x0006
    iMotors_voltageL  0x7E00
    iiMotors_voltageH 0x0006
    iiMotors_voltageL 0x8200
    iMotors_currentH  0x0006
    iMotors_currentL  0x8E00
    iiMotors_currentH 0x0006
    iiMotors_currentL 0x9200
    iStatictext1H     0x0006
    iStatictext1L     0x9E00
    iStatictext2H     0x0006
    iStatictext2L     0xA000
    iStatictext3H     0x0006
    iStatictext3L     0xA200
    iStatictext4H     0x0006
    iStatictext4L     0xA400
    iStatictext7H     0x0006
    iStatictext7L     0xA600
    iStatictext5H     0x0006
    iStatictext5L     0xAA00
    Inputs          0
#END



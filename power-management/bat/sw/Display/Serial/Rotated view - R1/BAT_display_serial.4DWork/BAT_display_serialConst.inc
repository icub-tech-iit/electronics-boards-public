// File generated 9/24/2020 10:40:52 AM
// Warning! This is a generated file, any manual changes will be
// lost during the next generation.

#constant  Strings1Count    1
#constant  Strings1Size     8
#constant  Strings2Count    1
#constant  Strings2Size     8
#constant  Strings3Count    1
#constant  Strings3Size     8
#constant  Strings4Count    1
#constant  Strings4Size     8
#constant  Strings5Count    1
#constant  Strings5Size     8
#constant  Strings1StartH   0x9
#constant  Strings1StartL   0xFE00
#constant  Strings2StartH   0xA
#constant  Strings2StartL   0x0
#constant  Strings3StartH   0xA
#constant  Strings3StartL   0x200
#constant  Strings4StartH   0xA
#constant  Strings4StartL   0x400
#constant  Strings5StartH   0xA
#constant  Strings5StartL   0x600
// object indexes for Inputs, Image Addresses + Input Array
#CONST
    iCPUH             0x0000
    iCPUL             0x0000
    iMotorsH          0x0000
    iMotorsL          0x0E00
    iBattery_voltageH 0x0000
    iBattery_voltageL 0x1E00
    iGauge1H          0x0001
    iGauge1L          0x3C00
    iBattery_percentH 0x0006
    iBattery_percentL 0xAA00
    iiBattery_percentH 0x0006
    iiBattery_percentL 0xAE00
    iStatictext7H     0x0006
    iStatictext7L     0xBA00
    iStatictext5H     0x0006
    iStatictext5L     0xBE00
    iBattery_ampsH    0x0006
    iBattery_ampsL    0xC000
    iR1H              0x0009
    iR1L              0x6800
    iR1_rightH        0x0009
    iR1_rightL        0x9A00
    iR1_leftH         0x0009
    iR1_leftL         0xCC00
    Inputs          0
#END



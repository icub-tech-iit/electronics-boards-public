// File generated 10/13/2024 4:52:47 PM
// Warning! This is a generated file, any manual changes will be
// lost during the next generation.

#constant  Strings1Count    1
#constant  Strings1Size     8
#constant  Strings2Count    1
#constant  Strings2Size     8
#constant  Strings3Count    1
#constant  Strings3Size     8
#constant  Strings4Count    1
#constant  Strings4Size     8
#constant  cpuFaultCount    0
#constant  cpuFaultSize     1
#constant  motorFaultCount    0
#constant  motorFaultSize     1
#constant  erroCpuLineCount    0
#constant  erroCpuLineSize     1
#constant  errorMotorLineCount    0
#constant  errorMotorLineSize     1
#constant  lastCpuValCount    0
#constant  lastCpuValSize     1
#constant  lastMotorValCount    0
#constant  lastMotorValSize     1
#constant  Strings1StartH   0x17
#constant  Strings1StartL   0x7400
#constant  Strings2StartH   0x17
#constant  Strings2StartL   0x7600
#constant  Strings3StartH   0x17
#constant  Strings3StartL   0x7800
#constant  Strings4StartH   0x17
#constant  Strings4StartL   0x7A00
#constant  cpuFaultStartH   0x17
#constant  cpuFaultStartL   0x7C00
#constant  motorFaultStartH   0x17
#constant  motorFaultStartL   0x7E00
#constant  erroCpuLineStartH   0x17
#constant  erroCpuLineStartL   0x8000
#constant  errorMotorLineStartH   0x17
#constant  errorMotorLineStartL   0x8200
#constant  lastCpuValStartH   0x17
#constant  lastCpuValStartL   0x8400
#constant  lastMotorValStartH   0x17
#constant  lastMotorValStartL   0x8600

// object indexes for Inputs, Image Addresses + Input Array
#CONST
    iCPUH             0x0000
    iCPUL             0x0000
    iMotorsH          0x0000
    iMotorsL          0x0E00
    iBattery_voltageH 0x0000
    iBattery_voltageL 0x1E00
    ibatteryChargeTankH 0x0001
    ibatteryChargeTankL 0xEC00
    iBattery_percentH 0x0005
    iBattery_percentL 0x2E00
    iiBattery_percentH 0x0005
    iiBattery_percentL 0x3200
    iChargeStringH    0x0005
    iChargeStringL    0x3E00
    ichargePercH      0x0005
    ichargePercL      0x4200
    iBattery_ampsH    0x0005
    iBattery_ampsL    0x4400
    ixCubImageH       0x0007
    ixCubImageL       0xEC00
    iStatusDecH       0x0008
    iStatusDecL       0x4C00
    iiStatusDecH      0x0008
    iiStatusDecL      0x5000
    iStatusStringH    0x0008
    iStatusStringL    0x5C00
    ibatteryChargeGaugeH 0x0008
    ibatteryChargeGaugeL 0x6000
    ibatteryChargeDigitH 0x0017
    ibatteryChargeDigitL 0x2C00
    iibatteryChargeDigitH 0x0017
    iibatteryChargeDigitL 0x3000
    ibatteryChargePercSimbH 0x0017
    ibatteryChargePercSimbL 0x3C00
    iBatteryLedH      0x0017
    iBatteryLedL      0x4000
    iBatteryChargeTitleH 0x0017
    iBatteryChargeTitleL 0x5E00
    Inputs          0
#END



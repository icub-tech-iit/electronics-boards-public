// File generated 8/28/2024 10:56:28 AM
// Warning! This is a generated file, any manual changes will be
// lost during the next generation.

#constant  Strings1Count    1
#constant  Strings1Size     6
#constant  Strings2Count    1
#constant  Strings2Size     6
#constant  Strings3Count    1
#constant  Strings3Size     6
#constant  Strings4Count    1
#constant  Strings4Size     6
#constant  Strings5Count    1
#constant  Strings5Size     6
#constant  Strings6Count    0
#constant  Strings6Size     1
#constant  Strings7Count    0
#constant  Strings7Size     1
#constant  Strings8Count    0
#constant  Strings8Size     1
#constant  Strings9Count    0
#constant  Strings9Size     1
#constant  Strings10Count    0
#constant  Strings10Size     1
#constant  Strings11Count    0
#constant  Strings11Size     1
#constant  Strings12Count    0
#constant  Strings12Size     1
#constant  Strings13Count    0
#constant  Strings13Size     1
#constant  Strings1StartH   0x8
#constant  Strings1StartL   0x5A00
#constant  Strings2StartH   0x8
#constant  Strings2StartL   0x5C00
#constant  Strings3StartH   0x8
#constant  Strings3StartL   0x5E00
#constant  Strings4StartH   0x8
#constant  Strings4StartL   0x6000
#constant  Strings5StartH   0x8
#constant  Strings5StartL   0x6200
#constant  Strings6StartH   0x8
#constant  Strings6StartL   0x6400
#constant  Strings7StartH   0x8
#constant  Strings7StartL   0x6600
#constant  Strings8StartH   0x8
#constant  Strings8StartL   0x6800
#constant  Strings9StartH   0x8
#constant  Strings9StartL   0x6A00
#constant  Strings10StartH   0x8
#constant  Strings10StartL   0x6C00
#constant  Strings11StartH   0x8
#constant  Strings11StartL   0x6E00
#constant  Strings12StartH   0x8
#constant  Strings12StartL   0x7000
#constant  Strings13StartH   0x8
#constant  Strings13StartL   0x7200

// object indexes for Inputs, Image Addresses + Input Array
#CONST
    iCPUH             0x0000
    iCPUL             0x0000
    iMotorsH          0x0000
    iMotorsL          0x0E00
    iBattery_voltageH 0x0000
    iBattery_voltageL 0x1E00
    iGauge1H          0x0001
    iGauge1L          0xEC00
    iBattery_percentH 0x0005
    iBattery_percentL 0x2E00
    iiBattery_percentH 0x0005
    iiBattery_percentL 0x3200
    iStatictext7H     0x0005
    iStatictext7L     0x3E00
    iStatictext5H     0x0005
    iStatictext5L     0x4200
    iBattery_ampsH    0x0005
    iBattery_ampsL    0x4400
    iR1H              0x0007
    iR1L              0xEC00
    iStatusDecH       0x0008
    iStatusDecL       0x4600
    iiStatusDecH      0x0008
    iiStatusDecL      0x4A00
    iStatusStringH    0x0008
    iStatusStringL    0x5600
    Inputs          0
#END


